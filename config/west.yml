## config/west.yml
```yaml
manifest:
  defaults:
    revision: v0.3
  remotes:
    - name: zmkfirmware
      url-base: https://github.com/zmkfirmware
    # - name: mctechnology17
    #   url-base: https://github.com/mctechnology17
    #- name: m165437
    #  url-base: https://github.com/M165437
  projects:
    - name: zmk
      remote: zmkfirmware
      import: app/west.yml
    # - name: nice-view-gem
    #   remote: m165437
    #   revision: main
    # - name: zmk-nice-oled
    #   remote: mctechnology17
    #   revision: main
  self:
    path: config
```
